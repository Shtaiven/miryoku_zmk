// Copyright 2024 Manna Harbour
// https://github.com/manna-harbour/miryoku
//
// Modified 2024 by Steven Eisinger

#include "../miryoku/custom_config.h"
#include "../miryoku/mapping/52/shockboard.h"
#include "../miryoku/miryoku.dtsi"
